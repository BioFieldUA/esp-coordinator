## main/Kconfig.projbuild
```kconfig
menu "ESP32 Zigbee Coordinator Settings"
    depends on ZB_ENABLED && ZB_ZCZR

    config NCP_EXTERNAL_ANTENNA
        bool "Enable External Antenna"
        depends on !IDF_TARGET_ESP32H2
        default n
        help
            Select 'y' to use an external antenna (via IPEX/SMA). 
            Select 'n' to use the default antenna.

    if NCP_EXTERNAL_ANTENNA

        config NCP_ANTENNA_CONTROLLER_ENABLE_PIN
            int
            depends on IDF_TARGET_ESP32C6
            default -1
            range -1 29
            prompt "RF Switch power pin (set to -1 to use the default XIAO pin)"
            help
                Set the RF Switch power pin to enable the switch. If not specified, the default XIAO RF Switch pin will be used.

        config NCP_ANTENNA_SWITCH_PIN
            int
            default -1
            range -1 29
            prompt "Antenna switch pin (set to -1 to use the default pin)"
            help
                Set antenna switch pin. If not specified, the default antenna pin will be used.

    endif # NCP_EXTERNAL_ANTENNA

    choice NCP_BUS_MODE
        bool "Host Connection Mode"
        default NCP_BUS_MODE_UART
        help
            Select which mode does the device connection with the host, support UART/USB.

        config NCP_BUS_MODE_UART
            bool "UART"
        config NCP_BUS_MODE_USB
            bool "USB"
    endchoice

    if NCP_BUS_MODE_UART

        config NCP_BUS_UART_BAUD_RATE
            int
            default 115200
            range 9600 921600
            prompt "UART baud rate"
            help
                Set UART baud rate.

        config NCP_BUS_UART_BYTE_SIZE
            int
            default 3
            range 0 3
            prompt "UART word length (0-5bit, 1-6bit, 2-7bit, 3-8bit)"
            help
                Set UART word length are defined as follows:

                - 0x0: 5bits
                - 0x1: 6bits
                - 0x2: 7bits
                - 0x3: 8bits

        config NCP_BUS_UART_PARITY
            int
            default 0
            range 0 3
            prompt "UART parity (0-disable, 2-even, 3-odd)"
            help
                Set UART parity are defined as follows:

                - 0x0: Disable UART parity
                - 0x2: Enable UART even parity
                - 0x3: Enable UART odd parity

        config NCP_BUS_UART_STOP_BITS
            int
            default 1
            range 1 3
            prompt "UART stop bits (1-1bit, 2-1.5bits, 3-2bits)"
            help
                Set UART stop bits are defined as follows:

                - 0x1: 1bit
                - 0x2: 1.5bits
                - 0x3: 2bits

        config NCP_BUS_UART_FLOW_CONTROL
            int
            default 0
            range 0 3
            prompt "UART HW flow control mode (0-disable, 1-rts, 2-cts, 3-rtscts)"
            help
                Set UART HW flow control mode are defined as follows:

                - 0x0: disable hardware flow control
                - 0x1: enable RX hardware flow control (rts)
                - 0x2: enable TX hardware flow control (cts)
                - 0x3: enable hardware flow control

        config NCP_BUS_UART_NUM
            int
            range 0 2
            default 1
            prompt "UART number"
            help
                Set UART number.

        config NCP_BUS_UART_RX_PIN
            int
            default -1
            range -1 29
            prompt "UART RX pin (set to -1 to use the default RX pin)"
            help
                Set UART RX pin. If not specified, the default RX pin will be used.

        config NCP_BUS_UART_TX_PIN
            int
            default -1
            range -1 29
            prompt "UART TX pin (set to -1 to use the default TX pin)"
            help
                Set UART TX pin. If not specified, the default TX pin will be used.

        config NCP_BUS_UART_RTS_PIN
            int
            default -1
            range -1 29
            prompt "UART rts pin"
            help
                Set UART rts pin.

        config NCP_BUS_UART_CTS_PIN
            int
            default -1
            range -1 29
            prompt "UART cts pin"
            help
                Set UART cts pin.

    endif # NCP_BUS_MODE_UART

endmenu
```
